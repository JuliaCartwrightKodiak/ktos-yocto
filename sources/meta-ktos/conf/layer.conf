## sources/meta-ktos/conf/layer.conf
```bitbake
BBPATH =. "${LAYERDIR}:"
BBFILE_COLLECTIONS  += "ktos"
BBFILE_PATTERN_ktos  = "^${LAYERDIR}"
BBFILE_PRIORITY_ktos = "10"
LAYERVERSION_ktos    = "1"
BBFILES += " \
        ${LAYERDIR}/recipes-*/*/*.bb \
        ${LAYERDIR}/recipes-*/*/*.bbappend \
"
LAYERSERIES_COMPAT_ktos = "gatesgarth"
```

## sources/meta-microsys-auto/conf/distro/microsys-auto.conf
```bitbake
# Copyright (C) 2020-2021 MicroSys Electronics GmbH
# Author: Kay Potthoff <kay.potthoff@microsys.de>

require conf/distro/fsl-auto.conf

DISTRO = "microsys-auto"
DISTRO_NAME = "MicroSys Auto Linux BSP"
DISTRO_VERSION = "4.1.3"
MAINTAINER = "Kay Potthoff <kay.potthoff@microsys.de>"

TARGET_VENDOR = "-ms"
SDK_VENDOR = "-msbsp"

DISTRO_FEATURES_DEFAULT_append = " pfe pcie llce-can sja1110 "
```

## sources/meta-microsys-auto/conf/layer.conf
```bitbake
# Copyright (C) 2019-2021 MicroSys Electronics GmbH
# Author: Kay Potthoff <kay.potthoff@microsys.de>

# We have a conf and classes directory, add to BBPATH
BBPATH =. "${LAYERDIR}:"
BBFILE_COLLECTIONS += "microsys-auto"
BBFILE_PATTERN_microsys-auto  = "^${LAYERDIR}"
BBFILE_PRIORITY_microsys-auto = "10"
LAYERVERSION_microsys-auto    = "1"
BBFILES += " \
        ${LAYERDIR}/recipes-*/*/*.bb \
        ${LAYERDIR}/recipes-*/*/*.bbappend \
"
LAYERSERIES_COMPAT_microsys-auto = "gatesgarth"
```

## sources/meta-microsys-auto/conf/machine/s32g274acpcis.conf
```bitbake
#@TYPE: Machine
#@NAME: MicroSys S32G274ACPCIS
#@SOC: s32g274a
#@DESCRIPTION: Machine configuration for running the S32G274ACPCIS in 64-bit mode
#@MAINTAINER: Kay Potthoff <kay.potthoff@microsys.de>
# Copyright (C) 2020 MicroSys Electronics GmbH

require conf/machine/include/s32-gen1-board.inc

IMAGE_CLASSES += "image_types_microsys"

MACHINEOVERRIDES =. "s32g274acpcis:mpxs32g274a:"

UBOOT_DEFCONFIG = "s32g274acpcis_defconfig"
UBOOT_FLASH_DEFCONFIG = "s32g274acpcis_qspi_defconfig"

UBOOT_ENVBIN = "u-boot-${MACHINE}-default-environment.bin"

KERNEL_DEVICETREE ?= "freescale/s32g274acpcis.dtb"
KERNEL_DEFCONFIG ?= "s32g274acpcis_defconfig"
ITS_DEVICETREE_CFG ?= "conf@microsys_s32g274acpcis.dtb"

UBOOT_CONFIG = "sdcard qspi"
UBOOT_CONFIG[sdcard] = "${UBOOT_DEFCONFIG},,u-boot.${UBOOT_SUFFIX}"
UBOOT_CONFIG[qspi] = "${UBOOT_FLASH_DEFCONFIG},,u-boot.${UBOOT_SUFFIX}"

FLASHIMAGE_EXTRA1_FILE = "s32g274acpcis.${FLASHIMAGE_DTB_SUFFIX}"
FLASHIMAGE_ROOTFS = "microsys-image-base"

# Enable ATF
require ${@bb.utils.contains('DISTRO_FEATURES', 'atf', 'conf/machine/include/atf.inc', '', d)}
```

## sources/meta-microsys-auto/conf/machine/s32g274asbc.conf
```bitbake
#@TYPE: Machine
#@NAME: MicroSys S32G274ASBC
#@SOC: s32g274a
#@DESCRIPTION: Machine configuration for running the S32G274ASBC
#@MAINTAINER: Kay Potthoff <kay.potthoff@microsys.de>
# Copyright (C) 2020-2021 MicroSys Electronics GmbH

require conf/machine/include/s32g2.inc

IMAGE_CLASSES += "image_types_microsys"

MACHINEOVERRIDES =. "s32g274asbc:mpxs32g274a:"

UBOOT_DEFCONFIG = "s32g274asbc_defconfig"
UBOOT_FLASH_DEFCONFIG = "s32g274asbc_qspi_defconfig"

UBOOT_ENVBIN = "u-boot-${MACHINE}-default-environment.bin"

KERNEL_DEVICETREE ?= "freescale/s32g274asbc.dtb"
KERNEL_DEFCONFIG ?= "s32g274asbc_defconfig"
ITS_DEVICETREE_CFG ?= "conf@s32g274asbc"

UBOOT_CONFIG = "qspi sdcard"
UBOOT_CONFIG[sdcard] = "${UBOOT_DEFCONFIG},,u-boot.${UBOOT_SUFFIX}"
UBOOT_CONFIG[qspi] = "${UBOOT_FLASH_DEFCONFIG},,u-boot.${UBOOT_SUFFIX}"

FLASHIMAGE_EXTRA1_FILE = "s32g274asbc.${FLASHIMAGE_DTB_SUFFIX}"
FLASHIMAGE_ROOTFS = "microsys-image-base"
```

## sources/meta-microsys-auto/conf/machine/s32g274asbc2.conf
```bitbake
#@TYPE: Machine
#@NAME: MicroSys S32G274ASBC2
#@SOC: s32g274a
#@DESCRIPTION: Machine configuration for running the S32G274ASBC2
#@MAINTAINER: Kay Potthoff <kay.potthoff@microsys.de>
# Copyright (C) 2021 MicroSys Electronics GmbH

require conf/machine/include/s32g2.inc

IMAGE_CLASSES += "image_types_microsys"

MACHINEOVERRIDES =. "s32g274asbc2:mpxs32g274a:"

UBOOT_DEFCONFIG = "s32g274asbc2_defconfig"
UBOOT_FLASH_DEFCONFIG = "s32g274asbc2_qspi_defconfig"

UBOOT_ENVBIN = "u-boot-${MACHINE}-default-environment.bin"

KERNEL_DEVICETREE ?= "freescale/s32g274asbc2_m2.dtb freescale/s32g274asbc2_2g5.dtb"
KERNEL_DEFCONFIG ?= "s32g274asbc2_defconfig"
ITS_DEVICETREE_CFG ?= "conf@s32g274asbc2_m2"

UBOOT_CONFIG = "qspi sdcard"
UBOOT_CONFIG[sdcard] = "${UBOOT_DEFCONFIG},,u-boot.${UBOOT_SUFFIX}"
UBOOT_CONFIG[qspi] = "${UBOOT_FLASH_DEFCONFIG},,u-boot.${UBOOT_SUFFIX}"

FLASHIMAGE_EXTRA1_FILE = "s32g274asbc2.${FLASHIMAGE_DTB_SUFFIX}"
FLASHIMAGE_ROOTFS = "microsys-image-base"
```
